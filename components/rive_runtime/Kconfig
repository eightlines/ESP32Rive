## components/rive_runtime/Kconfig
```kconfig
menu "Rive runtime"

    config RIVE_TEXT
        bool "Text (HarfBuzz + SheenBidi)"
        default y
        help
            Builds Rive's text engine with HarfBuzz (shaping) and SheenBidi
            (bidirectional text). Fonts are embedded in the .riv file; glyphs
            are drawn as ordinary paths. Adds roughly 1 MB of code.

    config RIVE_LAYOUT
        bool "Layouts (Yoga)"
        default y
        help
            Builds Rive's layout engine (Yoga flexbox). Without it, layout
            components keep their unlaid-out positions.

    config RIVE_AUDIO
        bool "Audio (miniaudio)"
        default y
        help
            Builds Rive's audio engine (miniaudio: MP3 / WAV / FLAC / Vorbis
            decoding and mixing) so audio events in a .riv play. Built as
            an external engine: no audio device inside miniaudio; the app
            pulls mixed samples (see Rive player > Audio output).

    config RIVE_SCRIPTING
        bool "Scripting (Luau)"
        default y
        help
            Runs the scripts a .riv carries (Rive's Luau scripting): the
            Luau VM, plus libhydrogen to check the editor's signature on
            them. Scripts arrive compiled, so no compiler is built.
            Scripts that decode image bytes, or use the GPU canvas API,
            aren't supported.

    config RIVE_SCRIPTING_REQUIRE_SIGNED
        bool "Only run signed scripts"
        default n
        depends on RIVE_SCRIPTING
        help
            Drops scripts whose signature (added by the Rive editor on
            export) doesn't verify. Off: all scripts run, as in the
            editor.

endmenu
```

## components/thorvg/Kconfig
```kconfig
menu "ThorVG"

    config RIVE_THORVG_THREADS
        bool "Enable ThorVG task scheduler threads"
        default n
        help
            Builds ThorVG with its std::thread based task scheduler. Not
            used by this project: both cores are already used by rendering
            the frame in two lanes (Rive player -> Render on both CPU cores),
            and the player starts ThorVG without worker threads. Leave off.

    config RIVE_THORVG_FAST_GRADIENT
        bool "Faster linear-gradient spans"
        default y
        help
            Replaces ThorVG's per-pixel blend-operator call and spread-mode
            switch in linear-gradient spans with loops specialised per
            operator (components/thorvg/fast). Pixel-identical output.
            Turn off to compare against stock ThorVG.

    config RIVE_THORVG_SKIP_PARTIAL_CLEAR
        bool "Skip the dirty-region clear under an opaque background"
        default y
        help
            With partial redraw, ThorVG clears each changed region before
            redrawing it. The Rive player always draws an opaque full-frame
            background first, so that clear is redundant memory traffic.
            Pixel-identical output. Only applies while the clear colour is
            opaque.

    config RIVE_THORVG_RLE_CELL_PERCENT
        int "Scanline cell buffer size (% of ThorVG's default)"
        range 75 800
        default 200
        help
            ThorVG converts each shape outline to coverage spans in
            horizontal bands sized to fit a cell buffer of max(w, h) * 0.75
            cells. A band that needs more cells is discarded, halved and
            redone. 200 (twice the default size) avoids almost all of those
            restarts at 720x720 (about 20% less span-generation work), for
            about 29 KB per render lane (in PSRAM). Output is identical.
            75 = stock ThorVG.

    config RIVE_THORVG_HOT_IRAM
        bool "Experiment: run hot raster code from internal RAM"
        default n
        help
            Places ThorVG's hottest raster functions (the outline
            rasteriser and the gradient / solid span loops, about 17 KB) in
            IRAM instead of executing them from PSRAM through the caches
            (components/thorvg/linker.lf). Costs that much internal RAM,
            which is scarce once an animation is loaded. Measured on the
            car at 720 (2026-11-02): 14.4-14.5 fps off, 14.6 on, shape RLE
            and fill within 1-2% (the hot loops already stay in the
            instruction cache), so it's off by default.

endmenu
```

## main/Kconfig.projbuild
```kconfig
menu "Rive player"

    choice RIVE_EMBEDDED_FILE
        prompt "Embedded .riv file"
        default RIVE_FILE_CAR
        help
            Which test file from main/assets is built into the firmware.

        config RIVE_FILE_CAR
            bool "Off-road car (animation, gradients, clips)"
        config RIVE_FILE_BUTTON
            bool "Electrified button (state machine, touch, text)"
            depends on RIVE_TEXT
        config RIVE_FILE_SCROLL
            bool "Scroll snap (layouts, text, touch scrolling)"
            depends on RIVE_TEXT && RIVE_LAYOUT
        config RIVE_FILE_SOUND
            bool "Sound (audio event, from rive-runtime's tests)"
            depends on RIVE_AUDIO
    endchoice

    config RIVE_EMBEDDED_FILE_NAME
        string
        default "sample.riv" if RIVE_FILE_CAR
        default "electrified_button.riv" if RIVE_FILE_BUTTON
        default "scroll_snap.riv" if RIVE_FILE_SCROLL
        default "sound.riv" if RIVE_FILE_SOUND

    config RIVE_RENDER_HALF_RES
        bool "Render at 360x360 and upscale 2x with the PPA"
        default n
        help
            Rasterise the animation at half resolution (a quarter of the
            pixels) and let the P4's pixel-processing accelerator scale it up
            to the 720x720 panel. Much faster, slightly softer edges.

    config RIVE_DUAL_CORE
        bool "Render on both CPU cores"
        default y
        help
            Split the frame into a top and a bottom half, rendered in
            parallel: the top on core 1 (the Rive task), the bottom on core 0
            (a worker task). Each half has its own ThorVG canvas.

    config RIVE_LANE_CULLING
        bool "Skip draws outside each core's half"
        default y
        depends on RIVE_DUAL_CORE
        help
            Each lane uses an empty placeholder for draws whose bounds don't
            reach its rows, so it neither builds nor prepares them.

    config RIVE_IN_PLACE_UPDATES
        bool "Update changed shapes in place"
        default y
        help
            A draw whose path, transform or fill changed updates its existing
            ThorVG shape instead of getting a new one: no allocations, and
            ThorVG keeps what it can (a moved gradient keeps its colour
            table, a recoloured shape its coverage spans). Pixel-identical.
            Turn off to compare.

    config RIVE_PPA_BURST_SWEEP
        bool "Experiment: sweep the PPA burst length"
        default n
        help
            Cycles the PPA's DMA burst length through 128, 64, 32, 16 and 8
            bytes, two stats intervals each, and logs the active value. Use
            it to find the best trade-off between the background copy's
            speed and its memory contention with rendering. Measured on
            2026-11-01: 128 is best (shorter bursts only slow the copy and
            don't speed up rendering), so it stays off.

    config RIVE_RASTER_PROFILE
        bool "Experiment: profile ThorVG raster functions"
        default y
        help
            Wraps ThorVG's raster and span-preparation functions with cycle
            counters (linker --wrap) and logs, per core, how many ms per
            frame each one takes. Small overhead per call.

    config RIVE_PIE_GRADIENT
        bool "Use PIE (SIMD) for translucent gradient spans"
        default y
        depends on RIVE_THORVG_FAST_GRADIENT
        help
            Blends translucent linear-gradient spans 4 pixels at a time with
            the ESP32-P4's PIE vector instructions. At boot a self-test
            compares it with ThorVG's own loop on random data and logs the
            cycles per pixel of each; the PIE version is only used if it
            matched exactly.

    config RIVE_PARTIAL_REDRAW
        bool "Redraw only changed regions"
        default y
        help
            Keep ThorVG's shapes between frames and let it redraw only the
            screen regions whose content changed (ThorVG SmartRender). Only
            the changed rows are then copied to the panel. Animations that
            move everything every frame gain nothing, but don't lose much.

    config RIVE_BACKLIGHT_PERCENT
        int "Backlight brightness (%)"
        range 0 100
        default 100

    config RIVE_STATS_INTERVAL_MS
        int "Interval between FPS / timing log lines (ms)"
        default 2000

menu "Audio output"
        depends on RIVE_AUDIO

        config RIVE_AUDIO_OUT
            bool "Play Rive audio on the board's speaker (ES8311)"
            default y
            help
                Mixes the file's sounds with Rive's audio engine and plays
                them through the ES8311 codec and NS4150B amplifier to the
                2-pin MX1.25 speaker header (8 ohm, 1-3 W speaker, not
                included with the board). A task on core 0 pulls 5 ms
                blocks and logs the output level, so you can see sounds
                play without a speaker.

        config RIVE_AUDIO_VOLUME
            int "Volume (0-100)"
            range 0 100
            default 60
            depends on RIVE_AUDIO_OUT

        config RIVE_AUDIO_SAMPLE_RATE
            int "Sample rate (Hz)"
            default 48000
            depends on RIVE_AUDIO_OUT

        config RIVE_AUDIO_BUFFER_SECONDS
            int "Decode sounds up to this long in advance (s, 0 = never)"
            range 0 120
            default 10
            depends on RIVE_AUDIO_OUT
            help
                When the file loads, sounds up to this length are decoded
                once (and converted to the output's rate) into PSRAM, about
                188 KB per second at 48 kHz. Playing them then only mixes
                ready samples. Longer sounds keep being decoded while they
                play (each playing sound costs ~7% of a core for MP3).

        config RIVE_AUDIO_PIN_MCLK
            int "I2S MCLK GPIO"
            default 13
            depends on RIVE_AUDIO_OUT
        config RIVE_AUDIO_PIN_BCLK
            int "I2S BCLK (SCLK) GPIO"
            default 12
            depends on RIVE_AUDIO_OUT
        config RIVE_AUDIO_PIN_WS
            int "I2S WS (LRCK) GPIO"
            default 10
            depends on RIVE_AUDIO_OUT
        config RIVE_AUDIO_PIN_DOUT
            int "I2S data out GPIO (to ES8311 DSDIN)"
            default 9
            depends on RIVE_AUDIO_OUT
        config RIVE_AUDIO_PIN_PA
            int "Amplifier enable GPIO (NS4150B, active high)"
            default 53
            depends on RIVE_AUDIO_OUT
            help
                Pins default to the Waveshare ESP32-P4-86-Panel-ETH-2RO /
                ESP32-P4-WIFI6-Touch-LCD-4B wiki (I2C for the codec is the
                touch bus, GPIO 7 / 8). -1 if there is no amplifier pin.
    endmenu

endmenu
```
